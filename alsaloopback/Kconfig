## alsaloopback/Kconfig
```kconfig
# SPDX-License-Identifier: GPL-2.0-only
config AUDIO_LOOPBACK
	tristate "Audio loopback support"
	depends on SND
	select SND_PCM

	help
	  This is a alsa driver for audio loopback based audio capture/output devices.

	  To compile this driver as a module, choose M here: the
	  module will be called alsaloopback
```

## v4l2loopback/Kconfig
```kconfig
# SPDX-License-Identifier: GPL-2.0-only
config VIDEO_LOOPBACK
	tristate "Video loopback support"
	depends on VIDEO_V4L2

	help
	  This is a video4linux2 driver for video loopback based video capture/output devices.

	  To compile this driver as a module, choose M here: the
	  module will be called v4l2loopback
```
